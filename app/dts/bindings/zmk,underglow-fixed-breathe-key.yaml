## app/dts/bindings/zmk,underglow-fixed-breathe-key.yaml
```yaml
description: |
  Applies a persistent breathing overlay to a single key LED after the
  normal RGB underglow effect, layer overlay, and status indicators.
  This overlay can remain active even when the regular underglow is turned off.

compatible: "zmk,underglow-fixed-breathe-key"

properties:
  key-pos:
    type: int
    required: true
    description: |
      Logical key position to target.

  led-index:
    type: int
    required: false
    description: |
      Optional physical LED strip index. When present, it is used directly
      instead of resolving the key position through the RGB transform.

  color:
    type: int
    required: false
    default: 0xFFFFFF
    description: |
      RGB color encoded as 0xRRGGBB.

  period-ms:
    type: int
    required: false
    default: 2200
    description: |
      Full breathing cycle duration in milliseconds.

  min-brightness:
    type: int
    required: false
    default: 0
    description: |
      Minimum brightness as an 8-bit value from 0 to 255.

  max-brightness:
    type: int
    required: false
    default: 48
    description: |
      Maximum brightness as an 8-bit value from 0 to 255.
```
